## Documentation/devicetree/bindings/arm/atmel-pmc.txt
```
* Power Management Controller (PMC)

Required properties:
- compatible: Should be "atmel,<chip>-pmc".
	<chip> can be: at91rm9200, at91sam9260, at91sam9g45, at91sam9n12,
	at91sam9x5, sama5d3

- reg: Should contain PMC registers location and length

Examples:
	pmc: pmc@fffffc00 {
		compatible = "atmel,at91rm9200-pmc";
		reg = <0xfffffc00 0x100>;
	};

PMC Fast Startup Signals

The PMC Fast Start Signals are used as the wake up source to trigger the PMC
to wake up the system from the ULP1 mode.

required properties:
- compatible: should be "atmel,sama5d2-pmc-fast-startup".

optional properties:
- atmel,wakeup-rtc-timer: boolean to enable RTC alarm wake-up.
- atmel,wakeup-usb-resume: boolean to enable USB resume wake-up.
- atmel,wakeup-sdmmc-cd: boolean to enable SDMMC card detect wake-up.
- atmel,wakeup-rxlp-match: boolean to enable RXLP matching condition wake-up.
- atmel,wakeup-acc-comparison: boolean to enable ACC comparison wake-up.

The node contains child nodes for each wake-up input pin that the platform uses.

Input nodes

Required properties:
- reg: should contain the wake-up input index [0 - 10], to enable
  the corresponding wake-up input.

Optional properties:
- atmel,wakeup-active-high: boolean to declare the corresponding wake-up
  input described by the child be active high.
  The default is to be active low.

Example:

	pmc: pmc@f0014000 {
		compatible = "atmel,sama5d2-pmc";
		reg = <0xf0014000 0x160>;

		pmc_fast_restart {
			compatible = "atmel,sama5d2-pmc-fast-startup";
			#address-cells = <1>;
			#size-cells = <0>;

			atmel,wakeup-rtc-timer;

			wkpin: input@0 {
				reg = <0>;
			};

			gmac_wol: input@10 {
				reg = <10>;
				atmel,wakeup-active-high;
			};
		};
	};
```

## Documentation/devicetree/bindings/sound/atmel-i2s.txt
```
* Atmel I2S controller

Required properties:
- compatible:     Should be "atmel,sama5d2-i2s".
- reg:            Should be the physical base address of the controller and the
                  length of memory mapped region.
- interrupts:     Should contain the interrupt for the controller.
- dmas:           Should be a list of pairs of DMA controller phandle and flags.
- dma-names:      Should be a list of DMA channel name among "rx", "tx" or
                  "rx-tx".
- clocks:         Should be a list of phandles of clocks used by the controller
                  (1).
- clock-names:    Should be a list matching the clocks phandles list:
                  - "pclk" (peripheral clock) Required.
                  - "gclk" (generated clock) Optional (1).
                  - "aclk" (Audio PLL clock) Optional (1).

Optional properties:
- pinctrl-0:      Should specify pin control groups used for this controller.
- princtrl-names: Should contain only one value - "default".


(1) : Only the peripheral clock is required. The generated clock and the Audio
      PLL clock are optional and should only be set together.

Example:

	i2s@f8050000 {
		compatible = "atmel,sama5d2-i2s";
		reg = <0xf8050000 0x300>;
		interrupts = <54 IRQ_TYPE_LEVEL_HIGH 7>;
		dmas = <&dma0
			(AT91_XDMAC_DT_MEM_IF(0) | AT91_XDMAC_DT_PER_IF(1) |
			 AT91_XDMAC_DT_PERID(31))>,
		       <&dma0
			(AT91_XDMAC_DT_MEM_IF(0) | AT91_XDMAC_DT_PER_IF(1) |
			 AT91_XDMAC_DT_PERID(32))>;
		dma-names = "tx", "rx";
		clocks = <&i2s0_clk>, <&i2s0_gclk>, <&audio_pll_pmc>;
		clock-names = "pclk", "gclk", "aclk";
		pinctrl-names = "default";
		pinctrl-0 = <&pinctrl_i2s0_default>;
	};
```
